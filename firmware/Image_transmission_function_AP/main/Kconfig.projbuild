## firmware/Image_transmission_function_AP/main/Kconfig.projbuild
```kconfig
menu "Example Configuration"
    
    config EXAMPLE_CAMERA_VIDEO_BUFFER_NUMBER
        int "Camera video buffer number"
        default 2
        help
            Number of video buffers for the camera sensor.
            
            More buffers provide better performance and reduce frame drops,
            but consume more memory. Recommended range: 2-4 buffers.
            
            - 2 buffers: Minimum for basic operation
            - 3-4 buffers: Better performance for smooth streaming
            - Higher values: May improve performance but increase memory usage

    config EXAMPLE_ENABLE_CAM_SENSOR_PIC_VFLIP
        bool "Enable vertical image flip"
        default n
        help
            Enable vertical flipping of camera images when the sensor supports it.

            Enable this together with horizontal image flip to rotate the image 180 degrees.

    config EXAMPLE_ENABLE_CAM_SENSOR_PIC_HFLIP
        bool "Enable horizontal image flip"
        default n
        help
            Enable horizontal flipping of camera images when the sensor supports it.

            Enable this together with vertical image flip to rotate the image 180 degrees.

    config EXAMPLE_JPEG_COMPRESSION_QUALITY
        int "JPEG compression quality (%)"
        default 80
        range 1 100
        help
            JPEG compression quality percentage (1-100).

            Higher values produce better image quality but larger data streams:
            - 90-100: Excellent quality, high bandwidth usage
            - 70-90: Good quality, moderate bandwidth (recommended for UVC)
            - 50-70: Acceptable quality, lower bandwidth
            - 1-50: Poor quality, minimal bandwidth

            For UVC streaming, consider the USB bandwidth limitations
            and host system capabilities when choosing quality level.

            Recommended: 80 for balanced quality and performance.

    config EXAMPLE_HTTP_PART_BOUNDARY
        string "HTTP part boundary"
        default "123456789000000000000987654321"
        help
            HTTP multipart boundary string used for MJPEG streaming.
            
            This boundary separates different parts in the HTTP multipart response.
            Must be unique and not appear in the video data. The default value
            is designed to be unique and safe for most applications.

    config EXAMPLE_WIFI_AP_SSID
        string "Wi-Fi AP SSID"
        default "ESP32-P4C5-CAM"
        help
            SSID advertised by the ESP device in SoftAP mode.

    config EXAMPLE_WIFI_AP_PASSWORD
        string "Wi-Fi AP password"
        default ""
        help
            Password for the SoftAP network. Leave empty to create an open
            network. WPA2 passwords must be at least 8 characters.

    config EXAMPLE_WIFI_AP_CHANNEL
        int "Fallback/fixed Wi-Fi AP channel"
        default 36 if EXAMPLE_WIFI_AP_BAND_5G_ONLY
        default 6
        range 1 177
        help
            Channel used when automatic channel selection is disabled or fails.
            Use 1-13 for 2.4 GHz and 36-177 for 5 GHz.

    choice EXAMPLE_WIFI_AP_BAND_MODE
        prompt "Wi-Fi AP band"
        default EXAMPLE_WIFI_AP_BAND_5G_ONLY if SOC_WIFI_SUPPORT_5G || SLAVE_SOC_WIFI_SUPPORT_5G
        default EXAMPLE_WIFI_AP_BAND_2G_ONLY
        help
            Compile-time switch for the SoftAP frequency band. ESP32-C5 has
            one RF path, so the two bands cannot operate simultaneously.

        config EXAMPLE_WIFI_AP_BAND_5G_ONLY
            bool "5 GHz"
            depends on SOC_WIFI_SUPPORT_5G || SLAVE_SOC_WIFI_SUPPORT_5G

        config EXAMPLE_WIFI_AP_BAND_2G_ONLY
            bool "2.4 GHz (compatible)"
    endchoice

    config EXAMPLE_WIFI_AP_AUTO_CHANNEL
        bool "Automatically select the best AP channel"
        default y
        help
            Scan nearby networks before starting the SoftAP. In 2.4 GHz mode,
            choose the least congested channel from 1/6/11. In 5 GHz mode,
            choose from the non-DFS channels 36/40/44/48.

    config EXAMPLE_WIFI_AP_MAX_CONNECTIONS
        int "Wi-Fi AP max connections"
        default 4
        range 1 10
        help
            Maximum number of stations allowed to connect to the SoftAP.

    config EXAMPLE_MDNS_INSTANCE
        string "mDNS instance"
        default "web-cam"
        help
            mDNS instance name for service discovery.
            
            This name will be used to identify the camera service on the network.
            Other devices can discover this camera using this instance name
            through mDNS/Bonjour protocols.
    
    config EXAMPLE_MDNS_HOST_NAME
        string "mDNS host name"
        default "esp-web"
        help
            mDNS host name for the ESP32 device.
            
            This hostname will be used for network identification and can be
            accessed as "esp-web.local" on the local network (if mDNS is supported
            by the client device).

    config EXAMPLE_ENABLE_MIPI_CSI_CROP
        bool "Enable crop for MIPI-CSI video device"
        default n
        depends on EXAMPLE_ENABLE_MIPI_CSI_CAM_SENSOR && SOC_ISP_CROP_SUPPORTED
    
    if EXAMPLE_ENABLE_MIPI_CSI_CROP
        config EXAMPLE_MIPI_CSI_CROP_TOP_LEFT_H
            int "Crop region top-left horizontal coordinate"
            default 0
            help
                Horizontal coordinate of the top-left corner for the crop.
                Must be an even number and less than bottom-right horizontal coordinate.

        config EXAMPLE_MIPI_CSI_CROP_TOP_LEFT_V
            int "Crop region top-left vertical coordinate"
            default 0
            help
                Vertical coordinate of the top-left corner for the crop.
                Must be an even number and less than bottom-right vertical coordinate.

        config EXAMPLE_MIPI_CSI_CROP_WIDTH
            int "Crop region width"
            default 640
            help
                Width of the crop region in pixels.
                Must be greater than 0 and not exceed the sensor output width.

        config EXAMPLE_MIPI_CSI_CROP_HEIGHT
            int "Crop region height"
            default 480
            help
                Height of the crop region in pixels.
                Must be greater than 0 and not exceed the sensor output height.
    endif
endmenu

menu "Hardware test pins"
    config TEST_BOOT_GPIO
        int "BOOT GPIO (active low; -1 means not configured)"
        range -1 54
        default 35
    config TEST_I2C_SCL_GPIO
        int "External I2C SCL GPIO (-1 means not configured)"
        range -1 54
        default 47
    config TEST_I2C_SDA_GPIO
        int "External I2C SDA GPIO (-1 means not configured)"
        range -1 54
        default 46
endmenu
```

## firmware/Image_transmission_function_AP/sdkconfig.defaults.esp32p4
```kconfig
CONFIG_ESP32P4_SELECTS_REV_LESS_V3=y
CONFIG_ESP32P4_REV_MIN_100=y
CONFIG_ESP_DEFAULT_CPU_FREQ_MHZ_360=y
CONFIG_CAMERA_SC2336=n

CONFIG_IDF_EXPERIMENTAL_FEATURES=y

CONFIG_SPIRAM=y
CONFIG_SPIRAM_SPEED_200M=y

CONFIG_ESP_VIDEO_ENABLE_ISP_PIPELINE_CONTROLLER=y

CONFIG_EXAMPLE_ENABLE_CAM_SENSOR_PIC_VFLIP=y
CONFIG_EXAMPLE_ENABLE_CAM_SENSOR_PIC_HFLIP=y
CONFIG_EXAMPLE_CAMERA_VIDEO_BUFFER_NUMBER=3
CONFIG_EXAMPLE_JPEG_COMPRESSION_QUALITY=70

CONFIG_EXAMPLE_SELECT_CUSTOMIZED_DEV_BOARD=y
CONFIG_EXAMPLE_MIPI_CSI_SCCB_I2C_SCL_PIN=29
CONFIG_EXAMPLE_MIPI_CSI_SCCB_I2C_SDA_PIN=28
CONFIG_TEST_I2C_SCL_GPIO=47
CONFIG_TEST_BOOT_GPIO=35
CONFIG_TEST_I2C_SDA_GPIO=46
CONFIG_EXAMPLE_MIPI_CSI_SCCB_I2C_FREQ=100000
CONFIG_I2C_ENABLE_SLAVE_DRIVER_VERSION_2=y
CONFIG_EXAMPLE_MIPI_CSI_CAM_MOTOR_SCCB_I2C_SCL_PIN=29
CONFIG_EXAMPLE_MIPI_CSI_CAM_MOTOR_SCCB_I2C_SDA_PIN=28
CONFIG_EXAMPLE_DVP_SCCB_I2C_SCL_PIN=29
CONFIG_EXAMPLE_DVP_SCCB_I2C_SDA_PIN=28
CONFIG_EXAMPLE_SPI_CAM_0_SCCB_I2C_SCL_PIN=29
CONFIG_EXAMPLE_SPI_CAM_0_SCCB_I2C_SDA_PIN=28

CONFIG_SLAVE_IDF_TARGET_ESP32C5=y
CONFIG_ESP_HOSTED_CP_TARGET_ESP32C5=y
CONFIG_ESPTOOLPY_FLASHSIZE_16MB=y
# CONFIG_EXAMPLE_WIFI_AP_AUTO_CHANNEL is not set
CONFIG_CAMERA_GC2145_WRITE_REGS_DELAY_US=500

CONFIG_CAMERA_GC2145=y
CONFIG_CAMERA_GC2145_MIPI_RGB565_800X600_30FPS=y
CONFIG_CAMERA_GC2145_MIPI_DEFAULT_FMT_RGB565_800X600_30FPS=y

CONFIG_ESP_HOSTED_DFLT_TASK_FROM_SPIRAM=y
CONFIG_SPIRAM_ALLOW_STACK_EXTERNAL_MEMORY=y

CONFIG_ESP_TASK_WDT_CHECK_IDLE_TASK_CPU1=n
CONFIG_ESP_TASK_WDT_TIMEOUT_S=30
CONFIG_HEAP_POISONING_DISABLED=y
```

## firmware/Image_transmission_function_STA/main/Kconfig.projbuild
```kconfig
menu "Example Configuration"
    
    config EXAMPLE_CAMERA_VIDEO_BUFFER_NUMBER
        int "Camera video buffer number"
        default 2
        help
            Number of video buffers for the camera sensor.
            
            More buffers provide better performance and reduce frame drops,
            but consume more memory. Recommended range: 2-4 buffers.
            
            - 2 buffers: Minimum for basic operation
            - 3-4 buffers: Better performance for smooth streaming
            - Higher values: May improve performance but increase memory usage

    config EXAMPLE_ENABLE_CAM_SENSOR_PIC_VFLIP
        bool "Enable vertical image flip"
        default n
        help
            Enable vertical flipping of camera images when the sensor supports it.

            Enable this together with horizontal image flip to rotate the image 180 degrees.

    config EXAMPLE_ENABLE_CAM_SENSOR_PIC_HFLIP
        bool "Enable horizontal image flip"
        default n
        help
            Enable horizontal flipping of camera images when the sensor supports it.

            Enable this together with vertical image flip to rotate the image 180 degrees.

    config EXAMPLE_JPEG_COMPRESSION_QUALITY
        int "JPEG compression quality (%)"
        default 80
        range 1 100
        help
            JPEG compression quality percentage (1-100).

            Higher values produce better image quality but larger data streams:
            - 90-100: Excellent quality, high bandwidth usage
            - 70-90: Good quality, moderate bandwidth (recommended for UVC)
            - 50-70: Acceptable quality, lower bandwidth
            - 1-50: Poor quality, minimal bandwidth

            For UVC streaming, consider the USB bandwidth limitations
            and host system capabilities when choosing quality level.

            Recommended: 80 for balanced quality and performance.

    config EXAMPLE_HTTP_PART_BOUNDARY
        string "HTTP part boundary"
        default "123456789000000000000987654321"
        help
            HTTP multipart boundary string used for MJPEG streaming.
            
            This boundary separates different parts in the HTTP multipart response.
            Must be unique and not appear in the video data. The default value
            is designed to be unique and safe for most applications.

    config EXAMPLE_WIFI_AP_SSID
        string "Wi-Fi AP SSID"
        default "P4C5CAM"
        help
            SSID advertised by the ESP device in SoftAP mode.

    config EXAMPLE_WIFI_AP_PASSWORD
        string "Wi-Fi AP password"
        default ""
        help
            Password for the SoftAP network. Leave empty to create an open
            network. WPA2 passwords must be at least 8 characters.

    config EXAMPLE_WIFI_AP_CHANNEL
        int "SoftAP provisioning channel (2.4 GHz)"
        default 1
        range 1 13
        help
            Fixed 2.4 GHz channel for the SoftAP provisioning hotspot. The AP
            stays on 2.4 GHz while the STA joins the router (cross-band APSTA);
            it stays up for 30 seconds after the STA obtains an IP so the page
            can fetch and display the STA IP.

    config EXAMPLE_WIFI_AP_MAX_CONNECTIONS
        int "Wi-Fi AP max connections"
        default 4
        range 1 10
        help
            Maximum number of stations allowed to connect to the SoftAP.

    config EXAMPLE_MDNS_INSTANCE
        string "mDNS instance"
        default "web-cam"
        help
            mDNS instance name for service discovery.
            
            This name will be used to identify the camera service on the network.
            Other devices can discover this camera using this instance name
            through mDNS/Bonjour protocols.
    
    config EXAMPLE_MDNS_HOST_NAME
        string "mDNS host name"
        default "esp-web"
        help
            mDNS host name for the ESP32 device.
            
            This hostname will be used for network identification and can be
            accessed as "esp-web.local" on the local network (if mDNS is supported
            by the client device).

    config EXAMPLE_ENABLE_MIPI_CSI_CROP
        bool "Enable crop for MIPI-CSI video device"
        default n
        depends on EXAMPLE_ENABLE_MIPI_CSI_CAM_SENSOR && SOC_ISP_CROP_SUPPORTED
    
    if EXAMPLE_ENABLE_MIPI_CSI_CROP
        config EXAMPLE_MIPI_CSI_CROP_TOP_LEFT_H
            int "Crop region top-left horizontal coordinate"
            default 0
            help
                Horizontal coordinate of the top-left corner for the crop.
                Must be an even number and less than bottom-right horizontal coordinate.

        config EXAMPLE_MIPI_CSI_CROP_TOP_LEFT_V
            int "Crop region top-left vertical coordinate"
            default 0
            help
                Vertical coordinate of the top-left corner for the crop.
                Must be an even number and less than bottom-right vertical coordinate.

        config EXAMPLE_MIPI_CSI_CROP_WIDTH
            int "Crop region width"
            default 640
            help
                Width of the crop region in pixels.
                Must be greater than 0 and not exceed the sensor output width.

        config EXAMPLE_MIPI_CSI_CROP_HEIGHT
            int "Crop region height"
            default 480
            help
                Height of the crop region in pixels.
                Must be greater than 0 and not exceed the sensor output height.
    endif
endmenu

menu "Hardware test pins"
    config TEST_BOOT_GPIO
        int "BOOT GPIO (active low; -1 means not configured)"
        range -1 54
        default 35
    config TEST_I2C_SCL_GPIO
        int "External I2C SCL GPIO (-1 means not configured)"
        range -1 54
        default 47
    config TEST_I2C_SDA_GPIO
        int "External I2C SDA GPIO (-1 means not configured)"
        range -1 54
        default 46
endmenu
```

## firmware/components/color_detect/Kconfig
```kconfig
menu "color detect"
    config COLOR_DETECT_MODEL
        bool "Enable color detect model"
        default y
        help
            Enable the color detect model result handling path.
endmenu
```
